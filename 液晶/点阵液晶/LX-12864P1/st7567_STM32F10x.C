/*************************************************************/
// project    :	221-3059-1428
// driver IC  :	st7567
// LCD        :	1/65 duty, 1/9bias, 8.8V vop
// interface  :	SPI
// ver        :	00
// date       :  -07
// other      :	VDD 3.1v
/**************************************************************/
#include <stm32f10x.h>

#define  uchar  unsigned char
#define  uint   unsigned int
#define  code   const
#define uint8_t unsigned char 
#define uint16_t unsigned short

/* user BSP config*/
	#define  LCD_CS_0  GPIOD->BRR = GPIO_Pin_13
	#define  LCD_CS_1  GPIOD->BSRR = GPIO_Pin_13
	
	#define  LCD_SDA_0  GPIOD->BRR = GPIO_Pin_8
	#define  LCD_SDA_1  GPIOD->BSRR = GPIO_Pin_8

	#define  LCD_SCK_0  GPIOD->BRR = GPIO_Pin_15
	#define  LCD_SCK_1  GPIOD->BSRR = GPIO_Pin_15

	#define  LCD_RST_0  GPIOD->BRR = GPIO_Pin_5
	#define  LCD_RST_1  GPIOD->BSRR = GPIO_Pin_5
	
	#define  LCD_RS_0  GPIOD->BRR = GPIO_Pin_14
	#define  LCD_RS_1  GPIOD->BSRR = GPIO_Pin_14
	
#define ST7565_DELAY_IO	  	10

/* Device independent config*/
#define IO_ST7565_CS_0  	LCD_CS_0
#define IO_ST7565_CS_1  	LCD_CS_1

#define IO_ST7565_SDA_0 	LCD_SDA_0  
#define IO_ST7565_SDA_1 	LCD_SDA_1   

#define IO_ST7565_SCK_0 	LCD_SCK_0  
#define IO_ST7565_SCK_1 	LCD_SCK_1   

#define IO_ST7565_RST_0 	LCD_RST_0
#define IO_ST7565_RST_1 	LCD_RST_1

#define IO_ST7565_RS_0 		LCD_RS_0
#define IO_ST7565_RS_1 		LCD_RS_1


#define ST7565_OSHOOK_Delay_ms(x)  OSTimeDly(x)

/*----------------------------------------*/

void writec(uchar);
void stop(void);
void writed(uchar);


 uchar vop=0x29;

uchar code chara1[]= {
 /*--  调入了一幅图像：D:\ASM\Jun\#CMGG12864R\1.bmp  --*/
/*--  宽度x高度=128x64  --*/
0xFF,0x01,0x01,0x01,0x01,0x01,0x09,0x09,0xFD,0xFD,0x01,0x01,0x01,0x01,0x01,0x01,
0x01,0x01,0x01,0x01,0x01,0x01,0x01,0x01,0x01,0x01,0x01,0x01,0x01,0x01,0x01,0x01,
0x01,0x01,0x01,0x01,0x01,0x01,0x01,0x01,0x01,0x01,0x01,0x01,0x01,0x01,0x01,0x01,
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0xBF,0xBF,0xA0,0xA0,0x80,0x80,0x80,0x80,0x80,0x80,0x80,0x80,0x80,0x80,0x80,0xFF



 };




 uchar code chara2[]=

{
/*--  调入了一幅图像：D:\ASM\Jun\#CMGG12864R\Q.bmp  --*/
/*--  宽度x高度=128x64  --*/
0xE0,0x10,0x08,0x08,0x08,0x10,0xE0,0x00,0xE0,0x10,0x08,0x08,0x08,0x10,0xE0,0x00,
0xE0,0x10,0x08,0x08,0x08,0x10,0xE0,0x00,0xE0,0x10,0x08,0x08,0x08,0x10,0xE0,0x00,
0xE0,0x10,0x08,0x08,0x08,0x10,0xE0,0x00,0xE0,0x10,0x08,0x08,0x08,0x10,0xE0,0x00,
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0x0F,0x18,0x24,0x24,0x38,0x50,0x4F,0x00,0x0F,0x18,0x24,0x24,0x38,0x50,0x4F,0x00


};



void ST7565_IO_Delay(uint16_t t)
{
	while(t --);									  
}


 void delay1(unsigned int t)
{
  while(t>0)
  {
    t--;             //TT-					   `
    pause=1;
    if(pause==0)stop();
  }
}


 void flash(unsigned int t)
{
  while(t>0)
  {
    t--;             //TT-					   `


  }
}
//-----------------------------
        void stop()
        {
         flash(100);
         while(pause==0)
         {
          pause=1;
          key1=1;
          key2=1;
          if(key1==0)
          {
          flash(200);
          if(key1==0)
          {

          while(key1==0);
          flash(100);
            if(vop<63)
            {
            vop++;
			writec(0x81);
            writec(vop);}
            }
		 }
          else if(key2==0)
          {
           flash(100);
		   if(key2==0)
          {

           while(key2==0);
           flash(100);
           if(vop>0)
           {
            vop--;
			writec(0x81);
            writec(vop);
			}
           }
          }
         }
	   }

void ST7565_Write(uint8_t dat,uint8_t rs) //rs == 1 data rs==0  cmd 
{
	uint8_t i;
	IO_ST7565_SCK_0;
	IO_ST7565_CS_0;
	if(!rs)
	{
		IO_ST7565_RS_0; //Command
	}else{
		IO_ST7565_RS_1;
	}
	ST7565_IO_Delay(ST7565_DELAY_IO);
	for(i=0;i<8;i++)
	{ 
		if( dat & 0x80){
			IO_ST7565_SDA_1;
		}else{
			IO_ST7565_SDA_0;
		}
		dat <<=1;
		IO_ST7565_SCK_1;
		ST7565_IO_Delay(ST7565_DELAY_IO);
		IO_ST7565_SCK_0;
		ST7565_IO_Delay(ST7565_DELAY_IO);
	}
	ST7565_IO_Delay(ST7565_DELAY_IO);
	IO_ST7565_CS_1;
	IO_ST7565_RS_1;
	ST7565_IO_Delay(ST7565_DELAY_IO);
}

void writec(uchar com)
{ 
	ST7565_Write(com,0);
}

void writed(uchar dat)
{  
	ST7565_Write(dat,1);
}

void LCD7565_FullFill( uint8_t FillData )
{
	uint8_t i,j;
	for(i=0;i<8;i++)
	{
		ST7565_Write(i,0); //Set Page Address
		ST7565_Write(0x10,0); //Set Column Address(MSByte) = 0
		ST7565_Write(0x00,0); //Colum(LSByte) from S1 -> S128 auto add
		for(j=0;j<128;j++)
		{
			ST7565_Write( FillData,1 );
		}
	}
}

 void init ( )
{
	IO_ST7565_CS_1;
	IO_ST7565_RST_0;
	OSTimeDlyHMSM(0,0,0,10); //hard reset for 10ms
	IO_ST7565_RST_1;
	OSTimeDlyHMSM(0,0,0,10); 
	ST7565_Write(0xE2,0); //Soft Reset
	ST7565_Write(0xA2,0); //Duty bias set  0xA2 is light 0xA3 is dark
	//ST7565_Write(0xA7,0); //0xA7 reverse 0xA6 normal default normal
	ST7565_Write(0xA0,0); //ADC select S0->S131(?????S1-S128)
	ST7565_Write(0xC8,0); //com1 --> com64
	ST7565_Write(0x23,0); //V0 Voltage Regulator Internal Resistor Ratio Set 0x20~0x27
	ST7565_OSHOOK_Delay_ms(2);
	ST7565_Write(0x81,0); //V0 voltage set first cmd
	ST7565_Write(0x2f & 0x3F,0); //following V0 voltage set 0x00~0x3F
	ST7565_OSHOOK_Delay_ms(2);
	ST7565_Write(0xF8,0); //Booster Ratio Select Mode Set first cmd
	ST7565_Write(0x00 & 0x03,0); //following Booset Ratio Register Set 0x00~0x03
	ST7565_OSHOOK_Delay_ms(2);
	ST7565_Write(0x2F,0); //power control all on
	ST7565_OSHOOK_Delay_ms(2);
	ST7565_Write(0x40 + 0x00,0); //0x40 + Display Start Line(0)
  LCD7565_FullFill(0x00); //full clear  
	ST7565_Write(0xAF,0); //Display ON
}


void display(uchar dat1,uchar dat2)
{
   uchar row,col;

   for (row=0xb0; row<0xb8; row++)    //0XB0    0XB8
   {
      writec(row);//set page address
      writec(0x10);//set column address
      writec(0x00);
      for(col=0;col<128;col++)
      {
         writed(dat1);
         writed(dat2);
      }
   }

   delay1(50000);

}

void displaychar(uchar *p)
{
   uchar row,col;

   for (row=0xb0; row<0xb8; row++)
   {
      writec(row);//set page address
      writec(0x10);//set column address
      writec(0x00);
      for(col=0;col<128;col++)
      writed(*p++);
   }

   delay1(50000);

}
void main(void)
{
   delay1(1000);

    vop=0x29;	 //vop=9.1V
	//vop=0x15;	 //vop=7.1V
   init();
  while (1)
  {
      display(0xff,0xff);
      display(0x00,0x00);
      display(0x55,0xaa);
      display(0xaa,0x55);
      displaychar(chara1);
      displaychar(chara2);//vop_test();
  }
}
